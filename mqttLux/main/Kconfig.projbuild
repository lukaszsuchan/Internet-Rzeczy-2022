## mqttLux/main/Kconfig.projbuild
```kconfig
menu "Example Configuration"
    choice EXAMPLE_I2C_ADDRESS
        prompt "Select I2C address"
        default EXAMPLE_I2C_ADDRESS_LO
        help
            Select I2C address

        config EXAMPLE_I2C_ADDRESS_LO
            bool "BH1750_ADDR_LO"
            help
                Choose this when ADDR pin is floating or low.
        config EXAMPLE_I2C_ADDRESS_HI
            bool "BH1750_ADDR_HI"
            help
                Choose this when ADDR pin is high.
    endchoice
    choice EXAMPLE_CHIP_TYPE
        prompt "Select chip type"
        default EXAMPLE_TYPE_AM2301

        config EXAMPLE_TYPE_DHT11
            bool "DHT11"
        config EXAMPLE_TYPE_AM2301
            bool "DHT21/DHT22/AM2301/AM2302/AM2321"
        config EXAMPLE_TYPE_SI7021
            bool "Itead Si7021"
    endchoice

    config EXAMPLE_I2C_MASTER_SCL
        int "SCL GPIO Number"
        default 5 if IDF_TARGET_ESP8266
        default 6 if IDF_TARGET_ESP32C3
        default 19 if IDF_TARGET_ESP32 || IDF_TARGET_ESP32S2 || IDF_TARGET_ESP32S3
        help
            GPIO number for I2C Master clock line.

    config EXAMPLE_I2C_MASTER_SDA
        int "SDA GPIO Number"
        default 4 if IDF_TARGET_ESP8266
        default 5 if IDF_TARGET_ESP32C3
        default 18 if IDF_TARGET_ESP32 || IDF_TARGET_ESP32S2 || IDF_TARGET_ESP32S3
        help
            GPIO number for I2C Master data line.

    config BROKER_URL
        string "Broker URL"
        default "mqtt://mqtt.eclipseprojects.io"
        help
            URL of the broker to connect to

    config BROKER_URL_FROM_STDIN
        bool
        default y if BROKER_URL = "FROM_STDIN"

    config EXAMPLE_DATA_GPIO
        int "Data GPIO number"
        default 4 if IDF_TARGET_ESP8266 || IDF_TARGET_ESP32C3
        default 17 if IDF_TARGET_ESP32 || IDF_TARGET_ESP32S2 || IDF_TARGET_ESP32S3
        help
            GPIO number connected to DATA pin

    config EXAMPLE_INTERNAL_PULLUP
        bool "Enable internal pull-up resistor"
        default 0
        help
        	Check this option if you don't have external pull-up resistor on data GPIO.
        	DHT sensors that come mounted on a PCB generally have pull-up resistors on the data pin.
        	But for stable operation, it is recommended to provide an external pull-up resistor.

endmenu
```
